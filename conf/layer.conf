## conf/layer.conf
```bitbake
# We have a conf and classes directory, add to BBPATH
BBPATH .= ":${LAYERDIR}"

# We have recipes-* directories, add to BBFILES
BBFILES += "${LAYERDIR}/recipes-*/*/*.bb \
	${LAYERDIR}/recipes-*/*/*.bbappend"

BBFILE_COLLECTIONS += "meta-hili-bbb"
BBFILE_PATTERN_meta-hili-bbb = "^${LAYERDIR}/"
BBFILE_PRIORITY_meta-hili-bbb = "6"
```
